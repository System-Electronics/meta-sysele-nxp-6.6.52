## conf/machine/imx8mp-lpddr4-evk-af0130.conf
```bitbake
require conf/machine/imx8mp-lpddr4-evk.conf
require conf/machine/af0130.inc


MACHINE_ESSENTIAL_EXTRA_RDEPENDS += "kernel-module-isp-vvcam \
                                     kernel-module-af0130 \
                                     kernel-module-imx8-media-dev"
```
